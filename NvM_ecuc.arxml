AUTOSAR XML (schema 00048)
package /ActiveEcuC
  module config NvM: implementation-config-variant=VARIANT-PRE-COMPILE, module-description=NvM_Impl
    NvMCommon:
      NvMBswMMultiBlockJobStatusInformation = true
      NvMCompiledConfigId = 14
      NvMCrcNumOfBytes = 64
      NvMDatasetSelectionBits = 4
      NvMDevErrorDetect = true
      NvMDrvModeSwitch = true
      NvMDynamicConfiguration = false
      NvMJobPrioritization = false
      NvMMultiBlockCallback = NULL_PTR
      NvMPollingMode = true
      NvMSetRamBlockStatusApi = true
      NvMSizeStandardJobQueue = 56
      NvMVersionInfoApi = false
      NvMMaxNoOfWriteRetries = 1
      NvMMainFunctionPeriod = 0.01
      NvMUseBlockIdCheck = false
      NvMRepairRedundantBlocksApi = false
      NvMApiConfigClass = NVM_API_CONFIG_CLASS_3
      NvMSafeBswChecks = false
      NvMSizeImmediateJobQueue = 9
      NvMDetectedLossOfRedundancyCallback = NULL_PTR
    NvMCommonVendorParams:
      NvMKillWriteAllApi = true
      NvMCfgCbkIncludeList = Dem_Cbk.h
      NvMCfgCbkIncludeList = ErrM.h
      NvMCfgCbkIncludeList = DiagHandler_NvM.h
      NvMCfgCbkIncludeList = RtMeas_NvM.h
      NvMCfgCbkIncludeList = Rte_Cbk.h
      NvMCfgCbkIncludeList = diagnostics_z0.h
      NvMCfgCbkIncludeList = CddOsoh_Cbk.h
      NvMCfgCbkIncludeList = vSwUpdM_Appl.h
      NvMDataIntegrityIntBuffer = true
    MirrorConfigBlock (NvMBlockDescriptor):
      NvMBlockJobPriority = 127
      NvMBlockManagementType = NVM_BLOCK_NATIVE
      NvMBlockUseCrc = true
      NvMBlockUseSyncMechanism = false
      NvMBlockWriteProt = false
      NvMBswMBlockStatusInformation = false
      NvMInitBlockCallback = MirrorConfigBlock_NVM_Init_Callback
      NvMNvBlockLength = 4
      NvMNvBlockNum = 1
      NvMNvramBlockIdentifier = 56
      NvMRamBlockDataAddress = MirrorConfigBlock_NVRAM
      NvMReadRamBlockFromNvCallback = NULL_PTR
      NvMResistantToChangedSw = false
      NvMSelectBlockForReadAll = true
      NvMSelectBlockForWriteAll = true
      NvMSingleBlockCallback = MirrorConfigBlock_NVM_JobFinished_Callback
      NvMWriteBlockOnce = false
      NvMWriteRamBlockToNvCallback = NULL_PTR
      NvMUseServicePorts = false
      NvMUseJobendCallback = true
      NvMUseInitCallback = true
      NvMAutomaticBlockLength = false
      NvMBlockLengthCheck = true
      NvMBlockLengthCheckType = true
      NvMBlockCrcType = NVM_CRC16
      NvMRomBlockDataAddress = NULL_PTR
      NvMBlockUseCRCCompMechanism = false
      NvMBlockUseSetRamBlockStatus = true
      NvMInvokeCallbacksForReadAll = true
      NvMInvokeCallbacksForWriteAll = true
      NvMCheckLossOfRedundancy = false
      NvMTargetBlockReference
        NvMFeeRef: NvMNameOfFeeBlock=FeeMirrorConfigBlock
    InternalFaultsBlock (NvMBlockDescriptor):
      NvMBlockJobPriority = 0
      NvMBlockUseCrc = true
      NvMBlockUseSyncMechanism = true
      NvMBlockWriteProt = false
      NvMBswMBlockStatusInformation = false
      NvMInitBlockCallback = NULL_PTR
      NvMNvBlockLength = 12
      NvMNvramBlockIdentifier = 51
      NvMRamBlockDataAddress = NULL_PTR
      NvMReadRamBlockFromNvCallback = Rte_SetMirror_InternalFaultsBlock
      NvMResistantToChangedSw = false
      NvMRomBlockDataAddress = Rte_InternalFaultsBlock_ROM_NVBlock
      NvMSelectBlockForReadAll = true
      NvMSelectBlockForWriteAll = true
      NvMSingleBlockCallback = Rte_NvMNotifyJobFinished_InternalFaultsBlock
      NvMWriteBlockOnce = false
      NvMWriteRamBlockToNvCallback = Rte_GetMirror_InternalFaultsBlock
      NvMUseJobendCallback = true
      NvMUseInitCallback = false
      NvMAutomaticBlockLength = false
      NvMBlockLengthCheck = false
      NvMBlockLengthCheckType = true
      NvMRomBlockNum = 1
      NvMBlockUseCRCCompMechanism = false
      NvMBlockUseSetRamBlockStatus = true
      NvMNvBlockNum = 2
      NvMBlockCrcType = NVM_CRC16
      NvMBlockManagementType = NVM_BLOCK_REDUNDANT
      NvMInvokeCallbacksForReadAll = true
      NvMInvokeCallbacksForWriteAll = true
      NvMCheckLossOfRedundancy = false
      NvMUseServicePorts = true
      NvMTargetBlockReference
        NvMFeeRef: NvMNameOfFeeBlock=FeeInternalFaultsBlock
